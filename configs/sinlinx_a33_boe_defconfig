## configs/sinlinx_a33_boe_defconfig
```kconfig
BR2_arm=y
BR2_cortex_a7=y
BR2_TOOLCHAIN_BUILDROOT_GLIBC=y
BR2_GLIBC_VERSION_2_23=y
BR2_TOOLCHAIN_BUILDROOT_CXX=y
BR2_ROOTFS_MERGED_USR=y
BR2_PACKAGE_BUSYBOX_SHOW_OTHERS=y
BR2_PACKAGE_GREP=y
BR2_PACKAGE_AUTOFS=y
BR2_PACKAGE_E2TOOLS=y
BR2_PACKAGE_GENEXT2FS=y
BR2_PACKAGE_GENPART=y
BR2_PACKAGE_GENROMFS=y
BR2_PACKAGE_MAKEDEVS=y
BR2_PACKAGE_MMC_UTILS=y
BR2_PACKAGE_SUNXI_TOOLS=y
BR2_PACKAGE_HOST_MKE2IMG=y
BR2_PACKAGE_HOST_UBOOT_TOOLS=y
```
